## CMakeLists.txt
```
# SPDX-License-Identifier: Apache-2.0

cmake_minimum_required(VERSION 3.20.0)

find_package(Zephyr REQUIRED HINTS $ENV{ZEPHYR_BASE})
project(zephyr-wireguard-demo)

zephyr_library_include_directories(${ZEPHYR_WIREGUARD_MODULE_DIR}/include)

target_sources(app PRIVATE
  src/main.c
  src/wg.c
)
```

## prj.conf
```kconfig
CONFIG_NETWORKING=y
CONFIG_NET_LOG=y
CONFIG_NET_IPV6=y
CONFIG_NET_IPV4=y
CONFIG_NET_DHCPV4=y
CONFIG_NET_UDP=y
CONFIG_NET_TCP=y
CONFIG_NET_STATISTICS=y
CONFIG_NET_SOCKETS_SERVICE=y
CONFIG_POSIX_API=y

CONFIG_TEST_RANDOM_GENERATOR=y

CONFIG_NET_PKT_RX_COUNT=32
CONFIG_NET_PKT_TX_COUNT=32
CONFIG_NET_BUF_RX_COUNT=32
CONFIG_NET_BUF_TX_COUNT=32
CONFIG_NET_IF_UNICAST_IPV6_ADDR_COUNT=5
CONFIG_NET_IF_MCAST_IPV6_ADDR_COUNT=5
CONFIG_NET_IF_UNICAST_IPV4_ADDR_COUNT=1
CONFIG_NET_MAX_CONTEXTS=10

CONFIG_NET_IF_MAX_IPV6_COUNT=3
CONFIG_NET_IF_MAX_IPV4_COUNT=3

CONFIG_INIT_STACKS=y
CONFIG_PRINTK=y
CONFIG_NET_SHELL=y
CONFIG_NET_L2_ETHERNET=y

CONFIG_NET_CONFIG_NEED_IPV6=y
CONFIG_NET_CONFIG_NEED_IPV4=y
CONFIG_NET_CONFIG_SETTINGS=y

# First ethernet interface will use these settings
CONFIG_NET_CONFIG_MY_IPV6_ADDR="2001:db8::1"
CONFIG_NET_CONFIG_PEER_IPV6_ADDR="2001:db8::2"
CONFIG_NET_CONFIG_MY_IPV4_ADDR="192.0.2.1"
CONFIG_NET_CONFIG_PEER_IPV4_ADDR="192.0.2.2"

# Logging
CONFIG_LOG=y

# Wireguard configuration
CONFIG_WIREGUARD=y
CONFIG_WIREGUARD_MAX_SRC_IPS=4

# First VPN interface will use these settings
CONFIG_NET_SAMPLE_COMMON_VPN_PEER_IP_ADDR="192.0.2.2:51820"
CONFIG_NET_SAMPLE_COMMON_VPN_MY_ADDR="198.51.100.1/24,2001:db8:100::1/64"
CONFIG_NET_SAMPLE_COMMON_VPN_ALLOWED_PEER_ADDR="2001:db8:100::/64,198.51.100.0/24"
CONFIG_NET_SAMPLE_COMMON_VPN_MY_PRIVATE_KEY="lmAIbJR8PQOpgJxmfOydBiDbexTMEKsjglZ1sj3kIjs="
CONFIG_NET_SAMPLE_COMMON_VPN_PEER_PUBLIC_KEY="v/xiHtIDhnnMJV3SbqI+cChcSqfrU4zlhLUUbL1J8x4="

CONFIG_NET_IF_MAX_IPV6_COUNT=4
CONFIG_NET_IF_MAX_IPV4_COUNT=4
CONFIG_NET_IF_UNICAST_IPV6_ADDR_COUNT=2
CONFIG_NET_IF_UNICAST_IPV4_ADDR_COUNT=2
CONFIG_NET_RX_STACK_SIZE=2560
CONFIG_SYSTEM_WORKQUEUE_STACK_SIZE=2048
CONFIG_NET_TCP_WORKQ_STACK_SIZE=2048
```

## src/main.c
```c
/*
 * Copyright (c) 2023 Nordic Semiconductor
 * Copyright (c) 2025 Jukka Rissanen
 *
 * SPDX-License-Identifier: Apache-2.0
 */

#include <zephyr/logging/log.h>
LOG_MODULE_REGISTER(vpn_sample, LOG_LEVEL_DBG);

#include <stdio.h>
#include <stdlib.h>
#include <errno.h>

#include <zephyr/posix/unistd.h>
#include <zephyr/posix/poll.h>
#include <zephyr/posix/arpa/inet.h>
#include <zephyr/posix/sys/socket.h>
#include <zephyr/net/socket_service.h>

extern int init_vpn(void);

/* Echo received data back to sender */

#define MY_PORT 4242

#define MAX_SERVICES (CONFIG_ZVFS_POLL_MAX - 3)

BUILD_ASSERT(MAX_SERVICES > 0, "Need at least 4 poll fds, increase CONFIG_ZVFS_POLL_MAX");

K_MUTEX_DEFINE(lock);
static struct pollfd sockfd_tcp[MAX_SERVICES];
static int tcp_socket = -1;
static int udp_socket = -1;

static void receive_data(bool is_udp, struct net_socket_service_event *pev,
			 char *buf, size_t buflen);
static void tcp_accept_handler(struct net_socket_service_event *pev);
static void restart_echo_service(void);

static void tcp_service_handler(struct net_socket_service_event *pev)
{
	static char buf[1500];

	receive_data(false, pev, buf, sizeof(buf));
}

static void udp_service_handler(struct net_socket_service_event *pev)
{
	static char buf[1500];

	receive_data(true, pev, buf, sizeof(buf));
}

NET_SOCKET_SERVICE_SYNC_DEFINE_STATIC(service_udp, udp_service_handler, 1);
NET_SOCKET_SERVICE_SYNC_DEFINE_STATIC(service_accept, tcp_accept_handler, 1);
NET_SOCKET_SERVICE_SYNC_DEFINE_STATIC(service_tcp, tcp_service_handler, MAX_SERVICES);

static void client_list_init(void)
{
	k_mutex_lock(&lock, K_FOREVER);
	ARRAY_FOR_EACH_PTR(sockfd_tcp, sockfd) {
		sockfd->fd = -1;
	}
	k_mutex_unlock(&lock);
}

static void client_list_deinit(void)
{
	(void)net_socket_service_unregister(&service_tcp);

	k_mutex_lock(&lock, K_FOREVER);
	ARRAY_FOR_EACH_PTR(sockfd_tcp, sockfd) {
		if (sockfd->fd != -1) {
			close(sockfd->fd);
			sockfd->fd = -1;
		}
	}
	k_mutex_unlock(&lock);
}

static void client_list_try_add(int sock)
{
	int ret;

	k_mutex_lock(&lock, K_FOREVER);
	ARRAY_FOR_EACH_PTR(sockfd_tcp, sockfd) {
		if (sockfd->fd == -1) {
			sockfd->fd = sock;
			sockfd->events = POLLIN;

			ret = net_socket_service_register(&service_tcp, sockfd_tcp,
							  ARRAY_SIZE(sockfd_tcp), NULL);
			if (ret < 0) {
				LOG_ERR("Cannot register socket service handler (%d). "
					"Attempting to restart service.", ret);
				restart_echo_service();
			}
			k_mutex_unlock(&lock);
			return;
		}
	}
	k_mutex_unlock(&lock);
	LOG_WRN("Max capacity reached");
	close(sock);
}

static void client_list_remove(int client)
{
	int ret;

	k_mutex_lock(&lock, K_FOREVER);
	ARRAY_FOR_EACH_PTR(sockfd_tcp, sockfd) {
		if (sockfd->fd == client) {
			close(client);
			sockfd->fd = -1;
			ret = net_socket_service_register(&service_tcp, sockfd_tcp,
							  ARRAY_SIZE(sockfd_tcp), NULL);
			if (ret < 0) {
				LOG_ERR("Cannot register socket service handler (%d). "
					"Attempting to restart service.", ret);
				restart_echo_service();
			}
			break;
		}
	}
	k_mutex_unlock(&lock);
}

static void receive_data(bool is_udp, struct net_socket_service_event *pev,
			 char *buf, size_t buflen)
{
	struct pollfd *pfd = &pev->event;
	int client = pfd->fd;
	struct sockaddr_in6 addr;
	char addr_str[INET6_ADDRSTRLEN];
	socklen_t addrlen = sizeof(addr);
	int len, out_len;
	char *p;

	len = recvfrom(client, buf, buflen, 0,
		       (struct sockaddr *)&addr, &addrlen);
	if (len <= 0) {
		if (len < 0) {
			LOG_ERR("recv: %d", -errno);
		}
		if (!is_udp) {
			client_list_remove(client);
			inet_ntop(addr.sin6_family, &addr.sin6_addr, addr_str, sizeof(addr_str));
			LOG_INF("Connection from %s closed", addr_str);
		}
		return;
	}

	p = buf;
	do {
		if (is_udp) {
			out_len = sendto(client, p, len, 0,
					 (struct sockaddr *)&addr, addrlen);
		} else {
			out_len = send(client, p, len, 0);
		}

		if (out_len < 0) {
			LOG_ERR("sendto: %d", -errno);
			break;
		}

		p += out_len;
		len -= out_len;
	} while (len);
}

static void tcp_accept_handler(struct net_socket_service_event *pev)
{
	int client;
	int sock = pev->event.fd;
	char addr_str[INET6_ADDRSTRLEN];
	struct sockaddr_in6 client_addr;
	socklen_t client_addr_len = sizeof(client_addr);

	client = accept(sock, (struct sockaddr *)&client_addr, &client_addr_len);
	if (client < 0) {
		LOG_ERR("accept: %d. Restarting service.", -errno);
		restart_echo_service();
		return;
	}

	inet_ntop(client_addr.sin6_family, &client_addr.sin6_addr, addr_str, sizeof(addr_str));
	LOG_INF("Connection from %s (%d)", addr_str, client);

	client_list_try_add(client);
}

static int setup_tcp_socket(struct sockaddr_in6 *addr)
{
	socklen_t optlen = sizeof(int);
	int ret, sock, opt;

	sock = socket(AF_INET6, SOCK_STREAM, IPPROTO_TCP);
	if (sock < 0) {
		LOG_ERR("socket: %d", -errno);
		return -errno;
	}

	ret = getsockopt(sock, IPPROTO_IPV6, IPV6_V6ONLY, &opt, &optlen);
	if (ret == 0 && opt) {
		LOG_INF("IPV6_V6ONLY option is on, turning it off.");

		opt = 0;
		ret = setsockopt(sock, IPPROTO_IPV6, IPV6_V6ONLY, &opt, optlen);
		if (ret < 0) {
			LOG_WRN("Cannot turn off IPV6_V6ONLY option");
		} else {
			LOG_INF("Sharing same socket between IPv6 and IPv4");
		}
	}

	if (bind(sock, (struct sockaddr *)addr, sizeof(*addr)) < 0) {
		LOG_ERR("bind: %d", -errno);
		close(sock);
		return -errno;
	}

	if (listen(sock, 5) < 0) {
		LOG_ERR("listen: %d", -errno);
		close(sock);
		return -errno;
	}

	return sock;
}

static int setup_udp_socket(struct sockaddr_in6 *addr)
{
	socklen_t optlen = sizeof(int);
	int ret, sock, opt;

	sock = socket(AF_INET6, SOCK_DGRAM, IPPROTO_UDP);
	if (sock < 0) {
		LOG_ERR("socket: %d", -errno);
		return -errno;
	}

	ret = getsockopt(sock, IPPROTO_IPV6, IPV6_V6ONLY, &opt, &optlen);
	if (ret == 0 && opt) {
		LOG_INF("IPV6_V6ONLY option is on, turning it off.");

		opt = 0;
		ret = setsockopt(sock, IPPROTO_IPV6, IPV6_V6ONLY, &opt, optlen);
		if (ret < 0) {
			LOG_WRN("Cannot turn off IPV6_V6ONLY option");
		} else {
			LOG_INF("Sharing same socket between IPv6 and IPv4");
		}
	}

	if (bind(sock, (struct sockaddr *)addr, sizeof(*addr)) < 0) {
		LOG_ERR("bind: %d", -errno);
		close(sock);
		return -errno;
	}

	return sock;
}

static int start_echo_service(void)
{
	struct pollfd sockfd_accept, sockfd_udp;
	int tcp_sock, udp_sock, ret;
	struct sockaddr_in6 addr = {
		.sin6_family = AF_INET6,
		.sin6_addr = IN6ADDR_ANY_INIT,
		.sin6_port = htons(MY_PORT),
	};

	client_list_init();

	tcp_sock = setup_tcp_socket(&addr);
	if (tcp_sock < 0) {
		LOG_ERR("Failed to setup tcp listening socket");
		return tcp_sock;
	}

	udp_sock = setup_udp_socket(&addr);
	if (udp_sock < 0) {
		LOG_ERR("Failed to setup udp socket");
		ret = udp_sock;
		goto cleanup_tcp;
	}

	/* Register TCP listening socket to service handler */
	sockfd_accept = (struct pollfd){ .fd = tcp_sock, .events = POLLIN };
	ret = net_socket_service_register(&service_accept, &sockfd_accept, 1, NULL);
	if (ret < 0) {
		LOG_ERR("Cannot register socket service handler (%d)", ret);
		goto cleanup_sockets;
	}

	/* Register UDP socket to service handler */
	sockfd_udp = (struct pollfd){ .fd = udp_sock, .events = POLLIN };
	ret = net_socket_service_register(&service_udp, &sockfd_udp, 1, NULL);
	if (ret < 0) {
		LOG_ERR("Cannot register socket service handler (%d)", ret);
		goto cleanup_sockets;
	}

	k_mutex_lock(&lock, K_FOREVER);
	tcp_socket = tcp_sock;
	udp_socket = udp_sock;
	k_mutex_unlock(&lock);

	LOG_INF("Single-threaded TCP/UDP echo server waits "
		"for a connection on port %d", MY_PORT);

	return 0;

cleanup_sockets:
	close(udp_sock);
cleanup_tcp:
	close(tcp_sock);
	return -1;

}

static int stop_echo_service(void)
{
	client_list_deinit();
	(void)net_socket_service_unregister(&service_udp);
	(void)net_socket_service_unregister(&service_accept);

	k_mutex_lock(&lock, K_FOREVER);
	if (tcp_socket >= 0) {
		close(tcp_socket);
		tcp_socket = -1;
	}
	if (udp_socket >= 0) {
		close(udp_socket);
		udp_socket = -1;
	}
	k_mutex_unlock(&lock);

	return 0;
}

static void restart_echo_service(void)
{
	stop_echo_service();
	start_echo_service();
}


int main(void)
{
	init_vpn();

	start_echo_service();

	return 0;
}
```

## src/wg.c
```c
/*
 * Copyright (c) 2025 Nordic Semiconductor
 *
 * SPDX-License-Identifier: Apache-2.0
 */

#include <zephyr/logging/log.h>
LOG_MODULE_DECLARE(vpn_sample, LOG_LEVEL_DBG);

#include <zephyr/kernel.h>
#include <zephyr/sys/base64.h>
#include <zephyr/posix/sys/socket.h>
#include <zephyr/posix/unistd.h>
#include <zephyr/posix/arpa/inet.h>
#include <zephyr/net/virtual.h>
#include <zephyr/net/virtual_mgmt.h>
#include <zephyr/net/wireguard.h>

/* User data for the interface callback */
struct ud {
	struct net_if *vpn[CONFIG_WIREGUARD_MAX_PEER];
};

static void iface_cb(struct net_if *iface, void *user_data)
{
	struct ud *ud = user_data;

	if (net_if_l2(iface) != &NET_L2_GET_NAME(VIRTUAL)) {
		return;
	}

	if (!(net_virtual_get_iface_capabilities(iface) & VIRTUAL_INTERFACE_VPN)) {
		return;
	}

	for (int i = 0; i < CONFIG_WIREGUARD_MAX_PEER; i++) {
		if (ud->vpn[i] != NULL) {
			continue;
		}

		ud->vpn[i] = iface;
		return;
	}
}

static int setup_iface(struct net_if *iface,
		       const char *my_addresses,
		       const char *allowed_ip_addr,
		       const char *my_private_key,
		       const char *peer_public_key,
		       int keepalive_interval)
{
	struct virtual_interface_req_params params = { 0 };
	struct wireguard_peer_config peer_config = { 0 };
	struct sockaddr_storage addr = { 0 };
	struct sockaddr *paddr = (struct sockaddr *)&addr;
	struct net_if *peer_iface = NULL;
	uint8_t mask_len = 0;
	uint8_t private_key[NET_VIRTUAL_MAX_PUBLIC_KEY_LEN];
	struct net_if_addr *ifaddr;
	const char *addr_str, *next;
	bool status, found;
	size_t olen;
	int ret;

	(void)base64_decode(private_key, sizeof(private_key), &olen,
			    my_private_key, strlen(my_private_key));

	params.private_key.data = private_key;
	params.private_key.len = sizeof(private_key);

	ret = net_mgmt(NET_REQUEST_VIRTUAL_INTERFACE_SET_PRIVATE_KEY,
		       iface, &params, sizeof(params));

	memset(private_key, 0, sizeof(private_key));

	if (ret < 0) {
		LOG_ERR("Cannot set private key (%d)", ret);
		return ret;
	}

	addr_str = my_addresses;

	do {
		char my_addr[INET6_ADDRSTRLEN] = { 'N', 'o', ' ', 'I', 'P', '\0'};

		next = net_ipaddr_parse_mask(addr_str, strlen(addr_str),
					     paddr, &mask_len);
		if (next == NULL) {
			LOG_ERR("Cannot parse IP address \"%s\"", my_addresses);
			return -EINVAL;
		}

		inet_ntop(paddr->sa_family, net_sin(paddr)->sin_addr.s4_addr,
			  my_addr, sizeof(my_addr));

		if (paddr->sa_family == AF_INET) {
			struct sockaddr_in *addr4 = (struct sockaddr_in *)paddr;
			struct sockaddr_in mask;

			ifaddr = net_if_ipv4_addr_add(iface, &addr4->sin_addr,
						      NET_ADDR_MANUAL, 0);

			ret = net_mask_len_to_netmask(AF_INET, mask_len,
						      (struct sockaddr *)&mask);
			if (ret < 0) {
				LOG_ERR("Invalid network mask length (%d)", ret);
				return ret;
			}

			status = net_if_ipv4_set_netmask_by_addr(iface,
								 &addr4->sin_addr,
								 &mask.sin_addr);

		} else if (paddr->sa_family == AF_INET6) {
			struct sockaddr_in6 *addr6 = (struct sockaddr_in6 *)paddr;
			struct in6_addr netaddr6;

			ifaddr = net_if_ipv6_addr_add(iface, &addr6->sin6_addr,
						      NET_ADDR_MANUAL, 0);

			net_ipv6_addr_prefix_mask((uint8_t *)&addr6->sin6_addr,
						  (uint8_t *)&netaddr6,
						  mask_len);

			if (!net_if_ipv6_prefix_add(iface, &netaddr6, mask_len,
						    (uint32_t)0xffffffff)) {
				LOG_ERR("Cannot add %s to interface %d", my_addr,
					net_if_get_by_iface(iface));
				return -EINVAL;
			}

		} else {
			LOG_ERR("Cannot parse IP address \"%s\"", my_addr);
			return -EAFNOSUPPORT;
		}

		if (ifaddr == NULL) {
			LOG_ERR("Cannot add IP address \"%s\" to interface %d",
				my_addr, net_if_get_by_iface(iface));
			return -ENOENT;
		}

		addr_str = next;
	} while (addr_str != NULL && *addr_str != '\0');

	peer_config.public_key = peer_public_key;

	addr_str = allowed_ip_addr;
	found = false;

	do {
		next = net_ipaddr_parse_mask(addr_str, strlen(addr_str),
					     paddr, &mask_len);
		if (next == NULL) {
			LOG_ERR("Cannot parse IP address \"%s\"", allowed_ip_addr);
			return -EINVAL;
		}

		ARRAY_FOR_EACH(peer_config.allowed_ip, i) {
			if (peer_config.allowed_ip[i].is_valid) {
				continue;
			}

			if (paddr->sa_family == AF_INET) {
				struct sockaddr_in *addr4 = (struct sockaddr_in *)paddr;

				memcpy(&peer_config.allowed_ip[i].addr.in_addr,
				       &addr4->sin_addr,
				       sizeof(struct in_addr));
				peer_config.allowed_ip[i].addr.family = AF_INET;
				peer_config.allowed_ip[i].is_valid = true;
				peer_config.allowed_ip[i].mask_len = mask_len;
				found = true;

			} else if (addr.ss_family == AF_INET6) {
				struct sockaddr_in6 *addr6 = (struct sockaddr_in6 *)paddr;

				memcpy(&peer_config.allowed_ip[i].addr.in6_addr,
				       &addr6->sin6_addr,
				       sizeof(struct in6_addr));
				peer_config.allowed_ip[i].addr.family = AF_INET6;
				peer_config.allowed_ip[i].is_valid = true;
				peer_config.allowed_ip[i].mask_len = mask_len;
				found = true;

			} else {
				LOG_ERR("Cannot parse IP address \"%s\"", allowed_ip_addr);
				return -EAFNOSUPPORT;
			}

			break;
		}

		addr_str = next;
	} while (addr_str != NULL && *addr_str != '\0');

	if (!found) {
		LOG_ERR("Not enough space for allowed IP addresses");
		return -ENOMEM;
	}

	if (CONFIG_NET_SAMPLE_COMMON_VPN_PEER_IP_ADDR[0] == '\0') {
		LOG_ERR("Peer IP address is not set");
		return -EINVAL;
	}

	if (!net_ipaddr_parse(CONFIG_NET_SAMPLE_COMMON_VPN_PEER_IP_ADDR,
			      strlen(CONFIG_NET_SAMPLE_COMMON_VPN_PEER_IP_ADDR),
			      paddr)) {
		LOG_ERR("Cannot parse peer IP address \"%s\"",
			CONFIG_NET_SAMPLE_COMMON_VPN_PEER_IP_ADDR);
		return -EINVAL;
	}

	if (paddr->sa_family == AF_INET6) {
		memcpy(&peer_config.endpoint_ip, paddr, sizeof(struct sockaddr_in6));
	} else {
		memcpy(&peer_config.endpoint_ip, paddr, sizeof(struct sockaddr_in));
	}

	peer_config.keepalive_interval = keepalive_interval;

	ret = wireguard_peer_add(&peer_config, &peer_iface);
	if (ret < 0) {
		LOG_ERR("Cannot add peer (%d)", ret);
	} else if (ret > 0) {
		if (peer_iface != NULL) {
			LOG_INF("Added peer id %d using interface %d", ret,
				 net_if_get_by_iface(peer_iface));
		} else {
			LOG_INF("Added peer id %d", ret);
		}
	}

	LOG_DBG("Interface %d VPN setup done.", net_if_get_by_iface(iface));

	return 0;
}

int init_vpn(void)
{
	struct ud user_data;
	int ret;

	memset(&user_data, 0, sizeof(user_data));

	net_if_foreach(iface_cb, &user_data);

	/* This sample has support for one VPN connection.
	 */
	ret = setup_iface(user_data.vpn[0],
			  CONFIG_NET_SAMPLE_COMMON_VPN_MY_ADDR,
			  CONFIG_NET_SAMPLE_COMMON_VPN_ALLOWED_PEER_ADDR,
			  CONFIG_NET_SAMPLE_COMMON_VPN_MY_PRIVATE_KEY,
			  CONFIG_NET_SAMPLE_COMMON_VPN_PEER_PUBLIC_KEY,
			  CONFIG_NET_SAMPLE_COMMON_VPN_KEEPALIVE_INTERVAL);
	if (ret < 0) {
		return ret;
	}

	return 0;
}
```
